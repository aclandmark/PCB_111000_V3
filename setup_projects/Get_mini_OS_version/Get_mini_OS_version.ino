
/*
 At this point a template for Arduino programs is developed. 
 
 Some Arduino and standard C library functions are introduced and used.
 For example 
 Serial.begin(115200):    This initialises the UART for 57600 Baud (assuming an 8MHz clock)
 Serial.write:            This sends text to the PC
 Serial print:            This sends numbers to the PC as text
 atol/atoi:               C functions that convert a text string to a long / integer number
 ltoa:                    C function that converts a long number to text (askii characters)

 Note all characters received by the UART are saved to a buffer.
 Serial.readBytesUntil as implemented here reads these characters and transfers them
 to a separate buffer "num_as_string" stopping only when a cartridge return (cr) is detected
 or a defined number keypresses have been made (i.e. 20 or 30).
 The keypresses contained in the buffer "num_as_string" are then converted to a number. 
 

 The reason for resets is determined. Four resets are considered; these are
	POR (power on reset)
	WDT	(watch dog timeout) used to generate  a planned or soft ware reset (SW_reset)
	WDT with flag: Like the WDT but the code writes to the EEPROM immediately before the reset
	Ext Reset: 	Only generated by a keypress -r- at the "p/r   p/r...." prompt for these projects 
	
	For battery applications a BOR brown out reset can also be detected though these have not been implemented here.

At a later stage the WDT with interrupt will also be introduced. Here this is used is to reset programs 
preventing them from going unresponsive due to unexpected inputs or switch presses. All subroutines especially those 
involving keyboard input should be made WD proof with the wdr() command. This resets the WD timer and prevents a reset. 

This project accepts an integer number and prints out all the integer numbers by which it can be divided
 giving an integer result.
 
Subroutines Int_Num_to_PC_A and Int_Num_from_PC_A() can be found in  UNO_proj_resources\PC_comms\Arduino_Rx_Tx_UNO_pcb.c
Int_Num_from_PC_A() implements the backspace key press

*/
/*
EEPROM usage
0x3FF, 0x3FE and 0x3FD     OSCCAL
0x3FC and 0x3FB            PRN generator
0x3FA                      Reset source
 */


/************************************************************************************************************/
#include "mini_OS_version_header.h"

#define message_1 "\r\nEnter integer number:  PCB returns all factors of that number.(Press sw1 to cancel.)\r\n"
#define message_2 "New number?\r\n"
#define message_3 "\r\nCalculation cancelled. New number?\r\n"


#define BL 30                     //Buffer length

int main (void)  
  { 
    
 setup_HW_Arduino;



Timer_T0_10mS_delay_x_m(1);
I2C_TX_328_check();
waiting_for_I2C_master;
if (receive_byte_with_Nack()==1)
{TWCR = (1 << TWINT);

while(1){

Serial.write("\r\n");
I2C_Rx_get_version_A('0');
Serial.write("\r\n");
I2C_Rx_get_version_A('1');

Serial.write("\r\nPress\r\n\
3 Message from the OS (x to escape)\r\n\
4 Default project\r\n\
0 to escape\r\n");
switch (waitforkeypress_A()){
case '0':break;
case '3':str_counter = 0; do
{Read_Hello_world_string_A();newline_A();
str_counter += 1;
waitforkeypress_A();}
while (str_counter < 3);
break;
case '4': I2C_Tx_LED_dimmer();
wdt_enable(WDTO_30MS);
I2C_Tx_display(); break;}

Serial.write("\r\nAK to repeat");}
}
else TWCR = (1 << TWINT);
Serial.write("At p/g prompt press x for version\r\n");while(1)wdr();
 
SW_reset;
return 1;  }







/******************************************************************************************/
